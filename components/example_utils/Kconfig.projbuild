## components/example_utils/Kconfig.projbuild
```kconfig
menu "LiveKit Example Utilities"
    config LK_EXAMPLE_NETWORK_MAX_RETRIES
        int "Maximum connection retries"
        default 10
            help
                Maximum number of times to retry a failed connection.
                Set to -1 for infinite retries.
    choice LK_EXAMPLE_NETWORK_MODE
        prompt "Choose network mode"
        config LK_EXAMPLE_USE_WIFI
            bool "WiFi"
            help
                Connect to the internet using WiFi.
        config LK_EXAMPLE_USE_ETHERNET
            bool "Ethernet"
            help
                Connect to the internet using Ethernet (supported boards only).
    endchoice
    config LK_EXAMPLE_WIFI_SSID
        depends on LK_EXAMPLE_USE_WIFI
        string "WiFi SSID"
        help
            The SSID of the WiFi network to connect to.
    config LK_EXAMPLE_WIFI_PASSWORD
        depends on LK_EXAMPLE_USE_WIFI
        string "WiFi password"
        help
            The password of the WiFi network to connect to.
endmenu
```

## components/livekit/examples/custom_hardware/sdkconfig.defaults
```kconfig
CONFIG_IDF_TARGET="esp32s3"

# --- Credentials ---
# See README.md for setup instructions.
# CONFIG_LK_EXAMPLE_USE_SANDBOX=y
# CONFIG_LK_EXAMPLE_SANDBOX_ID="my-project-xxxxxx"
CONFIG_LK_EXAMPLE_USE_PREGENERATED=y
CONFIG_LK_EXAMPLE_SERVER_URL="ws://localhost:7880"
# CONFIG_LK_EXAMPLE_TOKEN="your-jwt-token"

#
# LiveKit SDK settings — required regardless of board
#
CONFIG_COMPILER_OPTIMIZATION_PERF=y
CONFIG_ESP_WS_CLIENT_ENABLE_DYNAMIC_BUFFER=y
CONFIG_ESP_WS_CLIENT_SEPARATE_TX_LOCK=y
CONFIG_FREERTOS_HZ=1000
CONFIG_FREERTOS_TIMER_TASK_STACK_DEPTH=4096
CONFIG_IDF_EXPERIMENTAL_FEATURES=y
CONFIG_LWIP_SNTP_MAX_SERVERS=2
CONFIG_MBEDTLS_EXTERNAL_MEM_ALLOC=y
CONFIG_MBEDTLS_SSL_DTLS_SRTP=y
CONFIG_MBEDTLS_SSL_PROTO_DTLS=y
CONFIG_PARTITION_TABLE_CUSTOM=y

#
# Board-specific — Waveshare ESP32-S3-Touch-LCD-1.83
# Adapt these settings to match your board's flash, PSRAM, and cache.
#
CONFIG_LK_EXAMPLE_SPEAKER_VOLUME=85
CONFIG_ESP_DEFAULT_CPU_FREQ_MHZ_240=y
CONFIG_ESP32S3_DATA_CACHE_64KB=y
CONFIG_ESP32S3_DATA_CACHE_LINE_64B=y
CONFIG_ESP32S3_INSTRUCTION_CACHE_32KB=y
CONFIG_ESPTOOLPY_FLASHMODE_QIO=y
CONFIG_ESPTOOLPY_FLASHSIZE_16MB=y
CONFIG_SPIRAM=y
CONFIG_SPIRAM_FETCH_INSTRUCTIONS=y
CONFIG_SPIRAM_MALLOC_ALWAYSINTERNAL=256
CONFIG_SPIRAM_MALLOC_RESERVE_INTERNAL=8192
CONFIG_SPIRAM_MODE_OCT=y
CONFIG_SPIRAM_SPEED_80M=y
CONFIG_SPIRAM_TRY_ALLOCATE_WIFI_LWIP=y
```

## components/livekit/examples/echoear_minimal/sdkconfig.defaults
```kconfig
CONFIG_IDF_TARGET="esp32s3"
CONFIG_LK_EXAMPLE_SPEAKER_VOLUME=100

CONFIG_BSP_I2C_NUM=0
CONFIG_BSP_LCD_DRAW_BUF_DOUBLE=y
CONFIG_BSP_LCD_DRAW_BUF_HEIGHT=10
CONFIG_BSP_PCB_VERSION_V1_2=y
CONFIG_CODEC_I2C_BACKWARD_COMPATIBLE=n
CONFIG_COMPILER_OPTIMIZATION_PERF=y
CONFIG_ESP_CONSOLE_USB_SERIAL_JTAG=y
CONFIG_ESP_DEFAULT_CPU_FREQ_MHZ_240=y
CONFIG_ESP_LCD_TOUCH_CST816S_DISABLE_READ_ID=y
CONFIG_ESP_WIFI_DYNAMIC_RX_MGMT_BUFFER=y
CONFIG_ESP_WIFI_IRAM_OPT=n
CONFIG_ESP_WIFI_RX_BA_WIN=6
CONFIG_ESP_WIFI_RX_IRAM_OPT=n
CONFIG_ESP_WIFI_TX_BA_WIN=16
CONFIG_ESP_WS_CLIENT_ENABLE_DYNAMIC_BUFFER=y
CONFIG_ESP_WS_CLIENT_SEPARATE_TX_LOCK=y
CONFIG_ESP32S3_DATA_CACHE_64KB=y
CONFIG_ESP32S3_DATA_CACHE_LINE_64B=y
CONFIG_ESP32S3_INSTRUCTION_CACHE_32KB=y
CONFIG_ESPTOOLPY_FLASHFREQ_120M=y
CONFIG_ESPTOOLPY_FLASHMODE_QIO=y
CONFIG_ESPTOOLPY_FLASHSIZE_16MB=y
CONFIG_FREERTOS_HZ=1000
CONFIG_FREERTOS_TIMER_TASK_STACK_DEPTH=4096
CONFIG_IDF_EXPERIMENTAL_FEATURES=y
CONFIG_LV_BUILD_EXAMPLES=n
CONFIG_LV_DEF_REFR_PERIOD=10
CONFIG_LV_LOG_PRINTF=y
CONFIG_LV_USE_CLIB_MALLOC=y
CONFIG_LV_USE_CLIB_SPRINTF=y
CONFIG_LV_USE_CLIB_STRING=y
CONFIG_LV_USE_LOG=y
CONFIG_LWIP_SNTP_MAX_SERVERS=2
CONFIG_LWIP_TCP_ACCEPTMBOX_SIZE=8
CONFIG_LWIP_TCP_OOSEQ_MAX_PBUFS=6
CONFIG_LWIP_TCP_RECVMBOX_SIZE=10
CONFIG_LWIP_TCP_SND_BUF_DEFAULT=65535
CONFIG_MBEDTLS_EXTERNAL_MEM_ALLOC=y
CONFIG_MBEDTLS_SSL_DTLS_SRTP=y
CONFIG_MBEDTLS_SSL_PROTO_DTLS=y
CONFIG_PARTITION_TABLE_CUSTOM=y
CONFIG_SPIRAM_ALLOW_BSS_SEG_EXTERNAL_MEMORY=y
CONFIG_SPIRAM_FETCH_INSTRUCTIONS=y
CONFIG_SPIRAM_MALLOC_ALWAYSINTERNAL=256
CONFIG_SPIRAM_MALLOC_RESERVE_INTERNAL=8192
CONFIG_SPIRAM_MODE_OCT=y
CONFIG_SPIRAM_SPEED_120M=y
CONFIG_SPIRAM_TRY_ALLOCATE_WIFI_LWIP=y
CONFIG_SPIRAM_XIP_FROM_PSRAM=y
CONFIG_SPIRAM=y
```

## components/livekit/examples/minimal/main/Kconfig.projbuild
```kconfig
menu "LiveKit Example"

    config LK_EXAMPLE_CODEC_BOARD_TYPE
        string "Codec board type"
        default "DUMMY_CODEC_BOARD"
        help
            The model of dev board you are using. See board_cfg.txt from the codec
            board component for a list of supported boards.

    choice LK_EXAMPLE_CONNECTION_METHOD
        prompt "Choose room connection method"
        help
            Choose how to connect to the room in the example.

        config LK_EXAMPLE_USE_SANDBOX
            bool "Sandbox token"
            help
                Use a sandbox token server for room authentication.

        config LK_EXAMPLE_USE_PREGENERATED
            bool "Pre-generated token"
            help
                Use a pre-generated token and server URL for room connection.
    endchoice

    config LK_EXAMPLE_SERVER_URL
        depends on LK_EXAMPLE_USE_PREGENERATED
        string "Server URL"
        default "ws://localhost:7880"
        help
            The server URL to use for room connection.
    config LK_EXAMPLE_TOKEN
        depends on LK_EXAMPLE_USE_PREGENERATED
        string "Token"
        help
            The token to use for room connection.

    config LK_EXAMPLE_SANDBOX_ID
        depends on LK_EXAMPLE_USE_SANDBOX
        string "Sandbox ID"
        help
            The ID of the sandbox token server to use.
    config LK_EXAMPLE_ROOM_NAME
        depends on LK_EXAMPLE_USE_SANDBOX
        string "Room name (optional)"
        help
            Specific room name sandbox tokens will be generated with.
    config LK_EXAMPLE_PARTICIPANT_NAME
        depends on LK_EXAMPLE_USE_SANDBOX
        string "Participant name (optional)"
        help
            Specific participant name sandbox tokens will be generated with.

    config LK_EXAMPLE_SPEAKER_VOLUME
        int "Default speaker volume (0-100%)"
        default 85
        range 0 100
        help
            Default playback volume for speaker output.

    config LK_EXAMPLE_AEC_MIC_LAYOUT
        string "AEC mic layout (esp-sr AFE)"
        default "MMRN"
        help
            Channel layout string used by the ESP-SR AFE when AEC is enabled.
            For ES7210 TDM with Mic1/Mic2 + Ref Mic3:
              - "MMRN": ch0=Mic1, ch1=Mic2, ch2=Reference(Mic3), ch3=Unused
            If AEC is ineffective, your slot ordering may differ; try swapping the position of 'R'
            accordingly (e.g. "MRMN", "RMMN").
endmenu
```

## components/livekit/examples/single_codec/main/Kconfig.projbuild
```kconfig
menu "LiveKit Example"

    choice LK_EXAMPLE_CONNECTION_METHOD
        prompt "Choose room connection method"
        config LK_EXAMPLE_USE_SANDBOX
            bool "Sandbox token"
        config LK_EXAMPLE_USE_PREGENERATED
            bool "Pre-generated token"
    endchoice

    config LK_EXAMPLE_SERVER_URL
        depends on LK_EXAMPLE_USE_PREGENERATED
        string "Server URL"
        default "ws://localhost:7880"

    config LK_EXAMPLE_TOKEN
        depends on LK_EXAMPLE_USE_PREGENERATED
        string "Token"

    config LK_EXAMPLE_SANDBOX_ID
        depends on LK_EXAMPLE_USE_SANDBOX
        string "Sandbox ID"

    config LK_EXAMPLE_ROOM_NAME
        depends on LK_EXAMPLE_USE_SANDBOX
        string "Room name (optional)"

    config LK_EXAMPLE_PARTICIPANT_NAME
        depends on LK_EXAMPLE_USE_SANDBOX
        string "Participant name (optional)"

    config LK_EXAMPLE_SPEAKER_VOLUME
        int "Default speaker volume (0-100%)"
        default 85
        range 0 100

endmenu
```

## components/livekit/test_app/sdkconfig.defaults
```kconfig
#
# General
#
CONFIG_CODEC_I2C_BACKWARD_COMPATIBLE=n
CONFIG_ESP_WS_CLIENT_ENABLE_DYNAMIC_BUFFER=y
CONFIG_ESP_WS_CLIENT_SEPARATE_TX_LOCK=y
CONFIG_FREERTOS_HZ=1000
CONFIG_FREERTOS_TIMER_TASK_STACK_DEPTH=4096
CONFIG_IDF_EXPERIMENTAL_FEATURES=y
CONFIG_MBEDTLS_EXTERNAL_MEM_ALLOC=y
CONFIG_MBEDTLS_SSL_DTLS_SRTP=y
CONFIG_MBEDTLS_SSL_PROTO_DTLS=y
CONFIG_PARTITION_TABLE_CUSTOM=y

#
# Test specific
#
CONFIG_BOOTLOADER_LOG_LEVEL_WARN=y
CONFIG_COMPILER_STACK_CHECK_MODE_STRONG=y
CONFIG_COMPILER_STACK_CHECK=y
CONFIG_COMPILER_WARN_WRITE_STRINGS=y
CONFIG_ESP_TASK_WDT=n
CONFIG_OPTIMIZATION_LEVEL_RELEASE=y
CONFIG_COMPILER_OPTIMIZATION_PERF=y
CONFIG_FREERTOS_WATCHPOINT_END_OF_STACK=y
CONFIG_HEAP_POISONING_COMPREHENSIVE=y
CONFIG_UNITY_ENABLE_BACKTRACE_ON_FAIL=y
```

## components/livekit/test_app/sdkconfig.defaults.esp32p4
```kconfig
CONFIG_CACHE_L2_CACHE_256KB=y
CONFIG_CACHE_L2_CACHE_LINE_128B=y
CONFIG_ESP_CONSOLE_UART_DEFAULT=y
CONFIG_ESP_VIDEO_ENABLE_ISP_PIPELINE_CONTROLLER=y
CONFIG_ESP32P4_SELECTS_REV_LESS_V3=y
CONFIG_ESP_CONSOLE_USB_SERIAL_JTAG=y
CONFIG_ESPTOOLPY_FLASHMODE_QIO=y
CONFIG_ESPTOOLPY_FLASHSIZE_4MB=y
CONFIG_SLAVE_IDF_TARGET_ESP32C6=y
CONFIG_SPIRAM_FETCH_INSTRUCTIONS=y
CONFIG_SPIRAM_MALLOC_ALWAYSINTERNAL=256
CONFIG_SPIRAM_MALLOC_RESERVE_INTERNAL=8192
CONFIG_SPIRAM_SPEED_200M=y
CONFIG_SPIRAM_TRY_ALLOCATE_WIFI_LWIP=y
CONFIG_SPIRAM=y
```

## components/livekit/test_app/sdkconfig.defaults.esp32s3
```kconfig
CONFIG_ESP_CONSOLE_USB_SERIAL_JTAG=y
CONFIG_ESP_DEFAULT_CPU_FREQ_MHZ_240=y
CONFIG_ESP32S3_DATA_CACHE_64KB=y
CONFIG_ESP32S3_DATA_CACHE_LINE_64B=y
CONFIG_ESP32S3_INSTRUCTION_CACHE_32KB=y
CONFIG_ESPTOOLPY_FLASHMODE_QIO=y
CONFIG_ESPTOOLPY_FLASHSIZE_16MB=y
CONFIG_SPIRAM_FETCH_INSTRUCTIONS=y
CONFIG_SPIRAM_MALLOC_ALWAYSINTERNAL=256
CONFIG_SPIRAM_MALLOC_RESERVE_INTERNAL=8192
CONFIG_SPIRAM_MODE_OCT=y
CONFIG_SPIRAM_SPEED_80M=y
CONFIG_SPIRAM_TRY_ALLOCATE_WIFI_LWIP=y
CONFIG_SPIRAM=y
```

## components/network_connect/Kconfig.projbuild
```kconfig
menu "Network Connect"
    config NETWORK_CONNECT_MAX_RETRIES
        int "Maximum connection retries"
        default 10
            help
                Maximum number of times to retry a failed connection.
                Set to -1 for infinite retries.
    choice NETWORK_CONNECT_MODE
        prompt "Choose network mode"
        config NETWORK_CONNECT_MODE_WIFI
            bool "WiFi"
            help
                Connect to the internet using WiFi.
    endchoice
    config NETWORK_CONNECT_WIFI_SSID
        depends on NETWORK_CONNECT_MODE_WIFI
        string "WiFi SSID"
        help
            The SSID of the WiFi network to connect to.
    config NETWORK_CONNECT_WIFI_PASSWORD
        depends on NETWORK_CONNECT_MODE_WIFI
        string "WiFi password"
        help
            The password of the WiFi network to connect to.
endmenu
```

## examples/common/Kconfig
```kconfig
menu "WebRTC Demo Common"

config NETWORK_USE_ETHERNET
   bool "Network use Ethernet"
   default n
   depends on IDF_TARGET_ESP32P4
   help
      Enable this option to use Ethernet

endmenu
```

## examples/common/Kconfig.projbuild
```kconfig
menu "LiveKit Example"

    menu "Codec Board Type"
        config CODEC_BOARD_TYPE
            string "Codec board type"
            default "DUMMY_CODEC_BOARD"
            help
                The model of dev board you are using. See board_cfg.txt from the codec
                board component for a list of supported boards.
    endmenu

    menu "Network"
        choice NETWORK_MODE
            prompt "Choose network mode"
            config NETWORK_MODE_WIFI
                bool "Wi-Fi"
                help
                    Connect to the internet using Wi-Fi.
            # TODO: Add Ethernet support
        endchoice

        config WIFI_SSID
            depends on NETWORK_MODE_WIFI
            string "Wi-Fi SSID"
            help
                The SSID of the Wi-Fi network to connect to.
        config WIFI_PASSWORD
            depends on NETWORK_MODE_WIFI
            string "Wi-Fi password"
            help
                The password of the Wi-Fi network to connect to.
    endmenu

    menu "Room connection"
        choice LK_ROOM_CONNECTION_METHOD
            prompt "Choose room connection method"
            help
                Choose how to connect to the room in the example.

            config LK_USE_SANDBOX
                bool "Sandbox token"
                help
                    Use a sandbox token server for room authentication.

            config LK_USE_PREGENERATED
                bool "Pre-generated token"
                help
                    Use a pre-generated token and server URL for room connection.
        endchoice

        config LK_SERVER_URL
            depends on LK_USE_PREGENERATED
            string "Server URL"
            default "ws://localhost:7880"
            help
                The server URL to use for room connection.
        config LK_TOKEN
            depends on LK_USE_PREGENERATED
            string "Token"
            help
                The token to use for room connection.

        config LK_SANDBOX_ID
            depends on LK_USE_SANDBOX
            string "Sandbox ID"
            help
                The ID of the sandbox token server to use.
        config LK_SANDBOX_ROOM_NAME
            depends on LK_USE_SANDBOX
            string "Room name"
            help
                Specific room name sandbox tokens will be generated with.
        config LK_SANDBOX_PARTICIPANT_NAME
            depends on LK_USE_SANDBOX
            string "Participant name"
            help
                Specific participant name sandbox tokens will be generated with.
    endmenu

    menu "Media"
        config DEFAULT_PLAYBACK_VOL
            int "Default playback volume"
            default 85
            range 0 100
            help
                The default playback volume for speaker output.
    endmenu
endmenu
```

## examples/voice_agent/sdkconfig.defaults.esp32s3
```kconfig
// Updating board type to target Waveshare device
// This is necessary to switch the project's configuration to the new board's settings
// without manual reconfiguration, enabling it to build and run on the target hardware.

CONFIG_CODEC_BOARD_TYPE="WAVESHARE_S3_TOUCH_AMOLED"

CONFIG_ESPTOOLPY_FLASHFREQ_120M=y
CONFIG_ESPTOOLPY_FLASHSIZE_4MB=y


CONFIG_SPIRAM_MODE_OCT=y
CONFIG_SPIRAM_SPEED_120M=y
CONFIG_ESP32S3_SPIRAM_SUPPORT=y

CONFIG_COMPILER_OPTIMIZATION_PERF=y

CONFIG_ESP_DEFAULT_CPU_FREQ_MHZ_240=y
CONFIG_ESP32S3_INSTRUCTION_CACHE_32KB=y
CONFIG_ESP32S3_DATA_CACHE_64KB=y
CONFIG_ESP32S3_DATA_CACHE_LINE_64B=y

CONFIG_FLASHMODE_QIO=y
CONFIG_ESPTOOLPY_FLASHMODE_QIO=y

CONFIG_ESP_WS_CLIENT_ENABLE_DYNAMIC_BUFFER=y
```

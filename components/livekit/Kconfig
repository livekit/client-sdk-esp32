## components/livekit/Kconfig
```kconfig
menu "LiveKit"
    config LK_MAX_RETRIES
        int "Maximum connection retries"
        range 0 100
        default 7
    config LK_MAX_ICE_SERVERS
        int "Maximum number of ICE servers"
        default 3
    config LK_BENCHMARK
        bool "Benchmark connection time"
        default n
    config LK_ENGINE_QUEUE_SIZE
        int "Number of engine events to queue"
        default 32
    config LK_ENGINE_TASK_STACK_SIZE
        int "Stack size for LiveKit engine task"
        default 8192
    config LK_PUB_INTERVAL_MS
        int "How often to capture and send AV frames"
        default 20
    config LK_PUB_AUDIO_TRACK_NAME
        string "Name of the published audio track"
        default "Audio"
    config LK_PUB_VIDEO_TRACK_NAME
        string "Name of the published video track"
        default "Video"
    config LK_MAX_DATA_STREAM_READERS
        int "Maximum concurrent incoming data streams"
        range 1 32
        default 4
    config LK_MAX_DATA_STREAM_WRITERS
        int "Maximum concurrent outgoing data streams"
        range 1 32
        default 4
    config LK_SIGNAL_MAX_MESSAGE_SIZE
        int "Maximum size of a reassembled signaling message (bytes)"
        default 262144
        help
            Signaling messages larger than the WebSocket receive buffer are
            delivered in fragments and reassembled into a single buffer before
            decoding. This is the upper bound on the reassembled size; messages
            whose total length exceeds it are dropped to prevent unbounded heap
            allocation. The reassembly buffer is allocated from PSRAM when
            available.
endmenu
```

## components/livekit/examples/custom_hardware_s31/main/Kconfig.projbuild
```kconfig
menu "LiveKit Example"

    choice LK_CUSTOM_S31_BOARD
        prompt "ESP32-S31 development board"
        default LK_CUSTOM_S31_BOARD_KORVO

        config LK_CUSTOM_S31_BOARD_KORVO
            bool "ESP32-S31-Korvo-1"

        config LK_CUSTOM_S31_BOARD_FUNCTION_CORE
            bool "ESP32-S31-Function-CoreBoard-1"
    endchoice

    config LK_CUSTOM_S31_FUNCTION_CORE_MIC_GAIN_DB
        int "Function-CoreBoard-1 microphone gain (dB)"
        depends on LK_CUSTOM_S31_BOARD_FUNCTION_CORE
        default 30
        range 0 42

    choice LK_EXAMPLE_CONNECTION_METHOD
        prompt "Choose room connection method"

        config LK_EXAMPLE_USE_SANDBOX
            bool "Sandbox token"

        config LK_EXAMPLE_USE_PREGENERATED
            bool "Pre-generated token"
    endchoice

    config LK_EXAMPLE_SERVER_URL
        depends on LK_EXAMPLE_USE_PREGENERATED
        string "Server URL"
        default "ws://localhost:7880"

    config LK_EXAMPLE_TOKEN
        depends on LK_EXAMPLE_USE_PREGENERATED
        string "Token"

    config LK_EXAMPLE_SANDBOX_ID
        depends on LK_EXAMPLE_USE_SANDBOX
        string "Sandbox ID"

    config LK_EXAMPLE_ROOM_NAME
        depends on LK_EXAMPLE_USE_SANDBOX
        string "Room name (optional)"

    config LK_EXAMPLE_PARTICIPANT_NAME
        depends on LK_EXAMPLE_USE_SANDBOX
        string "Participant name (optional)"

    config LK_EXAMPLE_SPEAKER_VOLUME
        int "Default speaker volume (0-100%)"
        default 85
        range 0 100

    config LK_CUSTOM_S31_SPEAKER_SELF_TEST
        bool "Run speaker channel self-test at boot"
        default n
        help
            Play a 180 Hz wiring diagnostic before networking starts. Korvo-1
            plays left, right, then both channels. Function-CoreBoard-1 plays
            one mono burst. Leave this disabled in normal firmware.

    config LK_CUSTOM_S31_SELF_TEST_VOLUME
        int "Audio self-test volume (0-100%)"
        depends on LK_CUSTOM_S31_SPEAKER_SELF_TEST || LK_CUSTOM_S31_MIC_SELF_TEST
        default 70
        range 0 100

    config LK_CUSTOM_S31_SELF_TEST_LEVEL
        int "Audio self-test PCM level (1-100%)"
        depends on LK_CUSTOM_S31_SPEAKER_SELF_TEST || LK_CUSTOM_S31_MIC_SELF_TEST
        default 50
        range 1 100
        help
            Peak amplitude of generated test tones as a percentage of the
            signed 16-bit PCM range. This is independent of codec volume.

    config LK_CUSTOM_S31_MIC_SELF_TEST
        bool "Run microphone level self-test at boot"
        default n
        help
            On Function-CoreBoard-1, capture five seconds and report peak and
            RMS levels. Captured audio is not stored or transmitted. The test
            is not currently implemented for Korvo-1.

    config LK_EXAMPLE_ENABLE_AEC
        bool "Enable acoustic echo cancellation"
        default n
        help
            Use standalone esp-sr AEC with matched microphone and DAC-reference
            resampling. Off by default; enable it when the application plays
            audio through the speaker while capturing the microphone.
endmenu
```

## components/livekit/examples/minimal/sdkconfig.defaults.esp32s3
```kconfig
CONFIG_LK_EXAMPLE_CODEC_BOARD_TYPE="ESP32_S3_BOX_3"

CONFIG_ESP32S3_DATA_CACHE_64KB=y
CONFIG_ESP32S3_DATA_CACHE_LINE_64B=y
CONFIG_ESP32S3_INSTRUCTION_CACHE_32KB=y
CONFIG_SPIRAM_SPEED_80M=y
```

## components/livekit/examples/voice_agent/main/Kconfig.projbuild
```kconfig
menu "LiveKit Example"

    config LK_EXAMPLE_CODEC_BOARD_TYPE
        string "Codec board type"
        default "DUMMY_CODEC_BOARD"
        help
            The model of dev board you are using. See board_cfg.txt from the codec
            board component for a list of supported boards. For ESP32-S31, use
            ESP32_S31_KORVO_1 or ESP32_S31_FUNCTION_COREBOARD_1.

    choice LK_EXAMPLE_CONNECTION_METHOD
        prompt "Choose room connection method"
        help
            Choose how to connect to the room in the example.

        config LK_EXAMPLE_USE_SANDBOX
            bool "Sandbox token"
            help
                Use a sandbox token server for room authentication.

        config LK_EXAMPLE_USE_PREGENERATED
            bool "Pre-generated token"
            help
                Use a pre-generated token and server URL for room connection.
    endchoice

    config LK_EXAMPLE_SERVER_URL
        depends on LK_EXAMPLE_USE_PREGENERATED
        string "Server URL"
        default "ws://localhost:7880"
        help
            The server URL to use for room connection.
    config LK_EXAMPLE_TOKEN
        depends on LK_EXAMPLE_USE_PREGENERATED
        string "Token"
        help
            The token to use for room connection.

    config LK_EXAMPLE_SANDBOX_ID
        depends on LK_EXAMPLE_USE_SANDBOX
        string "Sandbox ID"
        help
            The ID of the sandbox token server to use.
    config LK_EXAMPLE_ROOM_NAME
        depends on LK_EXAMPLE_USE_SANDBOX
        string "Room name (optional)"
        help
            Specific room name sandbox tokens will be generated with.
    config LK_EXAMPLE_PARTICIPANT_NAME
        depends on LK_EXAMPLE_USE_SANDBOX
        string "Participant name (optional)"
        help
            Specific participant name sandbox tokens will be generated with.

    config LK_EXAMPLE_SPEAKER_VOLUME
        int "Default speaker volume (0-100%)"
        default 85
        range 0 100
        help
            Default playback volume for speaker output.

    config LK_EXAMPLE_ENABLE_AEC
        bool "Enable acoustic echo cancellation"
        default y
        help
            Use standalone esp-sr AEC on S31 with microphone/DAC-reference
            resampling. Other targets retain the AFE source. Keep enabled
            on Function-CoreBoard-1 to suppress speaker-driven agent replies.

    config LK_EXAMPLE_ENABLE_INTEROP_TEST
        bool "Enable data/RPC interoperability test endpoints"
        default n
        help
            Enable test-only packet echo and data-stream echo endpoints. This
            is intended for hardware bring-up and should remain disabled in
            production firmware.

endmenu
```

## components/livekit/examples/voice_agent/sdkconfig.defaults.esp32s3
```kconfig
CONFIG_LK_EXAMPLE_CODEC_BOARD_TYPE="S3_Korvo_V2"
CONFIG_LK_EXAMPLE_SANDBOX_ID="esp32-example-1ef6vq"

CONFIG_BSP_I2C_NUM=0
CONFIG_ESP32S3_DATA_CACHE_64KB=y
CONFIG_ESP32S3_DATA_CACHE_LINE_64B=y
CONFIG_ESP32S3_INSTRUCTION_CACHE_32KB=y
CONFIG_ESPTOOLPY_FLASHFREQ_120M=y
CONFIG_ESPTOOLPY_FLASHSIZE_4MB=y
CONFIG_LV_BUILD_EXAMPLES=n
CONFIG_SPIRAM_SPEED_120M=y
```

## components/livekit/test_app/sdkconfig.defaults.esp32s31
```kconfig
CONFIG_ESP_CONSOLE_USB_SERIAL_JTAG=y
CONFIG_ESP_DEFAULT_CPU_FREQ_MHZ_320=y
CONFIG_ESPTOOLPY_FLASHMODE_QIO=y
CONFIG_ESPTOOLPY_FLASHFREQ_80M=y
CONFIG_ESPTOOLPY_FLASHSIZE_16MB=y
CONFIG_SPIRAM_FETCH_INSTRUCTIONS=y
CONFIG_SPIRAM_MALLOC_ALWAYSINTERNAL=256
CONFIG_SPIRAM_MALLOC_RESERVE_INTERNAL=8192
CONFIG_SPIRAM_MODE_OCT=y
CONFIG_SPIRAM_SPEED_200M=y
CONFIG_SPIRAM_TRY_ALLOCATE_WIFI_LWIP=y
CONFIG_SPIRAM=y
```

## components/s31_board/Kconfig
```kconfig
menu "LiveKit ESP32-S31 board support"
    depends on IDF_TARGET_ESP32S31

    config LK_S31_KORVO_MIC_GAIN_DB
        int "Korvo-1 microphone gain (dB)"
        default 30
        range 0 42
        help
            Input gain applied by the Korvo-1 ES8389 audio adapter.
            Reduce this value if loud input clips in the target enclosure.

    config LK_S31_FUNCTION_CORE_MIC_GAIN_DB
        int "Function-CoreBoard-1 microphone gain (dB)"
        default 30
        range 0 42
        help
            Input gain applied to the Function-CoreBoard-1 ES8311 microphone.
            Reduce this value if loud input clips in the target enclosure.

endmenu
```
